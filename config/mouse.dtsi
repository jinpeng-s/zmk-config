#include <dt-bindings/zmk/mouse.h>

//////////////////////////////

&mmv {
  acceleration-exponent = <1>;      // 1
  time-to-max-speed-ms = <0>;       // 40
  delay-ms = <0>;                   // 0
};

#define   MOUSE_MIN_SPEED   250
#define   MOUSE_MIN_UP      MOVE_Y(-MOUSE_MIN_SPEED)
#define   MOUSE_MIN_DOWN    MOVE_Y(MOUSE_MIN_SPEED)
#define   MOUSE_MIN_LEFT    MOVE_X(-MOUSE_MIN_SPEED)
#define   MOUSE_MIN_RIGHT   MOVE_X(MOUSE_MIN_SPEED)

#define   MOUSE_NOM_SPEED   1000
#define   MOUSE_NOM_UP      MOVE_Y(-MOUSE_NOM_SPEED)
#define   MOUSE_NOM_DOWN    MOVE_Y(MOUSE_NOM_SPEED)
#define   MOUSE_NOM_LEFT    MOVE_X(-MOUSE_NOM_SPEED)
#define   MOUSE_NOM_RIGHT   MOVE_X(MOUSE_NOM_SPEED)

#define   MOUSE_MAX_SPEED   -1000000
#define   MOUSE_MAX_UP      MOVE_Y(-MOUSE_MAX_SPEED)
#define   MOUSE_MAX_DOWN    MOVE_Y(MOUSE_MAX_SPEED)
#define   MOUSE_MAX_LEFT    MOVE_X(-MOUSE_MAX_SPEED)
#define   MOUSE_MAX_RIGHT   MOVE_X(MOUSE_MAX_SPEED)

//////////////////////////////

&msc {
  acceleration-exponent = <1>;      // 0
  time-to-max-speed-ms = <0>;       // 40
  delay-ms = <0>;                   // 10
};

#undef SCROLL_UP
#undef SCROLL_DOWN
#undef SCROLL_LEFT
#undef SCROLL_RIGHT

#define   SCROLL_SPEED   10
#define   SCROLL_UP      SCRL_Y(-SCROLL_SPEED)
#define   SCROLL_DOWN    SCRL_Y(SCROLL_SPEED)
#define   SCROLL_LEFT    SCRL_X(-SCROLL_SPEED)
#define   SCROLL_RIGHT   SCRL_X(SCROLL_SPEED)
