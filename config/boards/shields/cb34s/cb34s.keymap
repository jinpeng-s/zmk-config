#define K42 &none
#define K34 &none
#define K28 &none
#define K22 &none
#define K18 &none

/* source keypos definitions */
#include "../../../zmk-nodefree-config/keypos_def/keypos_34keys.h"

/* source the main keymap */
#include "base.keymap"

/* use 6-column layout*/
/ { chosen { zmk,matrix_transform = &default_transform; }; };
