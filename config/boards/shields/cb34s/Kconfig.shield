## config/boards/shields/cb34s/Kconfig.shield
```kconfig
# The Kconfig.shield file defines any additional Kconfig settings that may be
# relevant when using this keyboard.
# For most keyboards, there is just one additional configuration value for the
# shield itself.

config SHIELD_CB34S
    def_bool $(shields_list_contains,cb34s)
```

## config/boards/shields/jnpng28/Kconfig.defconfig
```kconfig
# The Kconfig.defconfig file is where overrides for various configuration
# settings that make sense to have different defaults when this shield is used.
# One main item that usually has a new default value set here is the
# ZMK_KEYBOARD_NAME value, which controls the display name of the device over
# USB and BLE.

if SHIELD_JNPNG28

config ZMK_KEYBOARD_NAME
    default "jnpng28"

endif
```

## config/boards/shields/jnpng28/Kconfig.shield
```kconfig
# The Kconfig.shield file defines any additional Kconfig settings that may be
# relevant when using this keyboard.
# For most keyboards, there is just one additional configuration value for the
# shield itself.

config SHIELD_JNPNG28
    def_bool $(shields_list_contains,jnpng28)
```
